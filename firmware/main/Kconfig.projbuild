## firmware/main/Kconfig.projbuild
```kconfig
menu "Example Configuration"

    config SHTC3_I2C_SDA_PIN
        int "I2C SDA Pin"
        default 4
        help
            GPIO number for I2C master data

    config SHTC3_I2C_SCL_PIN
        int "I2C SCL Pin"
        default 5
        help
            GPIO number for I2C master clock

    config PIR_FAR_ZONE_GPIO
        int "Far Zone PIR GPIO"
        default 3
        help
            GPIO number connected to the far-zone PIR sensor output.

    config PIR_NEAR_ZONE_GPIO
        int "Near Zone PIR GPIO"
        default 4
        help
            GPIO number connected to the near-zone PIR sensor output.

endmenu
```

## firmware/sdkconfig.defaults.esp32c3
```kconfig
CONFIG_IDF_TARGET="esp32c3"

# ESP32-C3-DevKitC-02 Settings
# Buttons
CONFIG_BSP_BUTTONS_NUM=1
CONFIG_BSP_BUTTON_1_TYPE_GPIO=y
CONFIG_BSP_BUTTON_1_GPIO=9
CONFIG_BSP_BUTTON_1_LEVEL=0
CONFIG_PIR_FAR_ZONE_GPIO=3
CONFIG_PIR_NEAR_ZONE_GPIO=4
CONFIG_ENABLE_ESP32_FACTORY_DATA_PROVIDER=y
CONFIG_ENABLE_ESP32_DEVICE_INSTANCE_INFO_PROVIDER=y
CONFIG_USE_FACTORY_DATA_FOR_COMMISSIONING_VALUES=y
# CONFIG_ENABLE_TEST_COMMISSIONING_CREDENTIALS is not set
CONFIG_CHIP_FACTORY_NAMESPACE_PARTITION_LABEL="fctry"
# CONFIG_EXAMPLE_DEVICE_INSTANCE_INFO_PROVIDER is not set
```
